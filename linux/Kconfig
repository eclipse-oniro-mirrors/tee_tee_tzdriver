## linux/Kconfig
```kconfig
menu "TEE OS"

config TZDRIVER
	tristate "Secure Execution Communicator driver"
	default n
	help
	  Provides a communication interface between userspace and
	  TrustZone Operating Environment.

config SECBOOT_IMG
	bool "tzdriver split secboot img into modem and ap"
	default n
	depends on KERNEL_CLIENT
	help
	  Macro defined for splitting modem and ap img

config SECBOOT_IMG_V2
	bool "tzdriver split modem and ap for v2"
	default n
	depends on KERNEL_CLIENT
	help
	  Macro defined for splitting modem and ap img v2

config ASAN_DEBUG
	bool "ASAN debug version"
	default n
	help
	  Macro defined for ASAN debug version

source  "../../../../base/tee/tee_tzdriver/linux/auth/Kconfig"
source  "../../../../base/tee/tee_tzdriver/linux/core/Kconfig"
source  "../../../../base/tee/tee_tzdriver/linux/tlogger/Kconfig"
source  "../../../../base/tee/tee_tzdriver/linux/agent_rpmb/Kconfig"
source  "../../../../base/tee/tee_tzdriver/linux/ion/Kconfig"
source  "../../../../base/tee/tee_tzdriver/linux/tui/Kconfig"
endmenu
```

## linux/auth/Kconfig
```kconfig
# Auth Configuration
config CLIENT_AUTH
	bool "Client Application Hash Auth"
	default n
	depends on TZDRIVER
	help
	  TEEOS CA code hash auth
```

## linux/tlogger/Kconfig
```kconfig
config TEELOG
	bool "Secure Execution Log Driver"
	default n
	depends on TZDRIVER
	help
	  TEEOS log

config TEE_LOG_ACHIVE_PATH
	string "Tee log achive path"
	default "/data/log/tee/last_teemsg"
	depends on TEELOG
	help
	  Last tee msg log path

choice
	prompt "Register tee log Mem"
	default PAGES_MEM
	depends on TEELOG

config PAGES_MEM
	bool "Register pages log mem"
	help
	  Register pages log mem

endchoice
```

## liteos/Kconfig
```kconfig
config DRIVERS_TZDRIVER
	bool "Secure Execution Communicator driver"
	default n
	depends on TEE_ENABLE
	help
	  Provides a communication interface between userspace and
	  TrustZone Operating Environment.
```
